## CMakeLists.txt
```
cmake_minimum_required(VERSION 3.20.0)
find_package(Zephyr REQUIRED HINTS $ENV{ZEPHYR_BASE})
project(kvm_hub)
target_sources(app PRIVATE src/main.c src/hid_dev.c src/cfg_svc.c src/nfc.c)
```

## prj.conf
```kconfig
CONFIG_BT=y
CONFIG_BT_CENTRAL=y
CONFIG_BT_PERIPHERAL=y
CONFIG_BT_MAX_CONN=7
CONFIG_BT_SMP=y
CONFIG_BT_SETTINGS=y
CONFIG_SETTINGS=y
CONFIG_FLASH=y
CONFIG_FLASH_PAGE_LAYOUT=y
CONFIG_FLASH_MAP=y
CONFIG_NVS=y
CONFIG_BT_DEVICE_NAME="8REC-KM"
CONFIG_GPIO=y
CONFIG_LOG=y
CONFIG_LOG_MODE_DEFERRED=y
CONFIG_MAIN_STACK_SIZE=4096
CONFIG_REBOOT=y
CONFIG_CLOCK_CONTROL_NRF_K32SRC_RC=y
CONFIG_CLOCK_CONTROL_NRF_K32SRC_500PPM=y
CONFIG_SERIAL=y
CONFIG_CONSOLE=y
CONFIG_UART_CONSOLE=y
CONFIG_UART_LINE_CTRL=y
CONFIG_USB_DEVICE_STACK_NEXT=y
CONFIG_CDC_ACM_SERIAL_INITIALIZE_AT_BOOT=y
CONFIG_BT_GATT_CLIENT=y
CONFIG_BT_GATT_DM=y
CONFIG_BT_HOGP=y
CONFIG_BT_ATT_TX_COUNT=12
CONFIG_HEAP_MEM_POOL_SIZE=2048
CONFIG_BT_BONDABLE=y
CONFIG_BT_MAX_PAIRED=8
CONFIG_BT_PRIVACY=n
CONFIG_BT_SMP_SC_PAIR_ONLY=n
CONFIG_LOG_BUFFER_SIZE=8192
CONFIG_BT_APP_PASSKEY=y
CONFIG_BT_GATT_DM_MAX_ATTRS=128
CONFIG_HEAP_MEM_POOL_SIZE=8192
CONFIG_BT_L2CAP_TX_BUF_COUNT=20
CONFIG_BT_BUF_ACL_RX_COUNT_EXTRA=3
CONFIG_BT_GATT_AUTO_DISCOVER_CCC=n
CONFIG_BT_HOGP_REPORTS_MAX=16
CONFIG_BT_FILTER_ACCEPT_LIST=y

# HID peripheral for the computers
CONFIG_BT_DEVICE_APPEARANCE=962
CONFIG_BT_BAS=y
CONFIG_BT_HIDS=y
CONFIG_BT_HIDS_INPUT_REP_MAX=3
CONFIG_BT_HIDS_OUTPUT_REP_MAX=1
CONFIG_BT_HIDS_FEATURE_REP_MAX=0
CONFIG_BT_HIDS_ATTR_MAX=40
CONFIG_BT_HIDS_MAX_CLIENT_COUNT=5
CONFIG_BT_HIDS_DEFAULT_PERM_RW_ENCRYPT=y
CONFIG_BT_GATT_UUID16_POOL_SIZE=64
CONFIG_BT_GATT_CHRC_POOL_SIZE=32
CONFIG_BT_CONN_CTX=y
CONFIG_BT_GATT_AUTO_SEC_REQ=n
CONFIG_BT_AUTO_PHY_UPDATE=n
CONFIG_BT_DIS=y
CONFIG_BT_DIS_MANUF_NAME=y
CONFIG_BT_DIS_MANUF_NAME_STR="DIY"
CONFIG_BT_DIS_PNP=y
CONFIG_BT_DIS_PNP_VID_SRC=2
CONFIG_BT_DIS_PNP_VID=0x1915
CONFIG_BT_DIS_PNP_PID=0xEEEF
CONFIG_BT_DIS_PNP_VER=0x0100

# second identity: the computers see their own address, the MX devices keep the first
CONFIG_BT_ID_MAX=3
CONFIG_BT_EXT_ADV=y
CONFIG_BT_SMP_ALLOW_UNAUTH_OVERWRITE=y

# controller link budget: two input devices (central) and two computers (peripheral)
CONFIG_BT_CTLR_SDC_PERIPHERAL_COUNT=5

CONFIG_SYSTEM_WORKQUEUE_STACK_SIZE=4096
CONFIG_BT_RX_STACK_SIZE=4096
CONFIG_THREAD_STACK_INFO=y
CONFIG_STACK_SENTINEL=y
CONFIG_RESET_ON_FATAL_ERROR=y

# configuration service (Web Bluetooth page): long values need a bigger ATT MTU, and a second advertising set
CONFIG_BT_L2CAP_TX_MTU=247
CONFIG_BT_BUF_ACL_RX_SIZE=251
CONFIG_BT_EXT_ADV_MAX_ADV_SET=3


# NFC tag (coil on the NFC pads): tapping a phone opens the setup page and the setup window
CONFIG_NFC_T2T_NRFXLIB=y
CONFIG_NFC_NDEF=y
CONFIG_NFC_NDEF_MSG=y
CONFIG_NFC_NDEF_RECORD=y
CONFIG_NFC_NDEF_URI_MSG=y
CONFIG_NFC_NDEF_URI_REC=y
CONFIG_NFC_PLATFORM=y
CONFIG_NRFX_NFCT=y
CONFIG_BT_BONDABLE_PER_CONNECTION=y
CONFIG_HWINFO=y

# radio time: every link used to reserve 7.5 ms per event, which seven links cannot share (computer links timed out or lost their
# update instant, reasons 0x08 and 0x28, and the pointer arrived in lumps). Reports are tiny: 2.5 ms per link is plenty.
CONFIG_BT_CTLR_SDC_MAX_CONN_EVENT_LEN_DEFAULT_OVERRIDE=y
CONFIG_BT_CTLR_SDC_MAX_CONN_EVENT_LEN_DEFAULT=2500
CONFIG_BT_CTLR_SDC_CENTRAL_ACL_EVENT_SPACING_DEFAULT=2500
```

## boards/xiao_ble_nrf52840_sense.overlay
```dts
/ {
    chosen {
        zephyr,console = &board_cdc_acm_uart;        // the board's own USB-C port (a serial port on the computer): no wires needed
        zephyr,shell-uart = &board_cdc_acm_uart;   // for the D6 TX / D7 RX adapter use &uart0 in both lines
    };
};
&uart0 { status = "okay"; current-speed = <115200>; };
&nfct { status = "okay"; };                              // NFC tag on the two NFC pads (P0.09 / P0.10)
```

## src/cfg_svc.c
```c
#include <string.h>
#include <zephyr/kernel.h>
#include <zephyr/logging/log.h>
#include <zephyr/bluetooth/gatt.h>
#include <zephyr/bluetooth/uuid.h>
#include <stdlib.h>
#include "cfg_svc.h"
#include "ringlog.h"

LOG_MODULE_REGISTER(cfg, LOG_LEVEL_INF);

// 5a6f0001-6b76-4d48-8f2e-7d9c1b2a3c4d (service), ...0002 state, ...0003 command
#define CFG_UUID(n) BT_UUID_128_ENCODE(0x5a6f0000 + (n), 0x6b76, 0x4d48, 0x8f2e, 0x7d9c1b2a3c4d)
static const struct bt_uuid_128 uuid_svc = BT_UUID_INIT_128(CFG_UUID(1));
static const struct bt_uuid_128 uuid_state = BT_UUID_INIT_128(CFG_UUID(2));
static const struct bt_uuid_128 uuid_cmd = BT_UUID_INIT_128(CFG_UUID(3));
static const struct bt_uuid_128 uuid_log = BT_UUID_INIT_128(CFG_UUID(4));          // write a line number, read the log from there (240 bytes per read)

static char snap[1400];
static size_t snap_len;

static ssize_t read_state(struct bt_conn *conn, const struct bt_gatt_attr *attr, void *buf, uint16_t len, uint16_t off)
{
    if (!cfg_access_ok(conn)) return BT_GATT_ERR(BT_ATT_ERR_AUTHORIZATION);
    if (off == 0) snap_len = cfg_status(snap, sizeof(snap));      // a long read continues on the same snapshot
    return bt_gatt_attr_read(conn, attr, buf, len, off, snap, snap_len);
}

// commands run on the work queue, not in the Bluetooth thread
static char pending[64];
static struct k_work cmd_work;
static void cmd_fn(struct k_work *w) { char c[sizeof(pending)]; strcpy(c, pending); cfg_command(c); }

static ssize_t write_cmd(struct bt_conn *conn, const struct bt_gatt_attr *attr, const void *buf, uint16_t len, uint16_t off, uint8_t flags)
{
    if (!cfg_access_ok(conn)) return BT_GATT_ERR(BT_ATT_ERR_AUTHORIZATION);
    if (off || len == 0 || len >= sizeof(pending)) return BT_GATT_ERR(BT_ATT_ERR_INVALID_ATTRIBUTE_LEN);
    if (k_work_busy_get(&cmd_work)) return BT_GATT_ERR(BT_ATT_ERR_PREPARE_QUEUE_FULL);
    memcpy(pending, buf, len);
    pending[len] = 0;
    k_work_submit(&cmd_work);
    return len;
}

static uint32_t log_pos;
static char log_chunk[240];
static size_t log_chunk_len;

static ssize_t read_log(struct bt_conn *conn, const struct bt_gatt_attr *attr, void *buf, uint16_t len, uint16_t off)
{
    if (!cfg_access_ok(conn)) return BT_GATT_ERR(BT_ATT_ERR_AUTHORIZATION);
    if (off == 0) log_chunk_len = ringlog_read(log_pos, log_chunk, sizeof(log_chunk));
    return bt_gatt_attr_read(conn, attr, buf, len, off, log_chunk, log_chunk_len);
}

static ssize_t write_log(struct bt_conn *conn, const struct bt_gatt_attr *attr, const void *buf, uint16_t len, uint16_t off, uint8_t flags)
{
    if (!cfg_access_ok(conn)) return BT_GATT_ERR(BT_ATT_ERR_AUTHORIZATION);
    char t[12];
    if (off || len == 0 || len >= sizeof(t)) return BT_GATT_ERR(BT_ATT_ERR_INVALID_ATTRIBUTE_LEN);
    memcpy(t, buf, len); t[len] = 0;
    log_pos = strtoul(t, NULL, 10);
    return len;
}

BT_GATT_SERVICE_DEFINE(cfg_svc,
    BT_GATT_PRIMARY_SERVICE(&uuid_svc),
    BT_GATT_CHARACTERISTIC(&uuid_state.uuid, BT_GATT_CHRC_READ, BT_GATT_PERM_READ, read_state, NULL, NULL),
    BT_GATT_CHARACTERISTIC(&uuid_cmd.uuid, BT_GATT_CHRC_WRITE | BT_GATT_CHRC_WRITE_WITHOUT_RESP, BT_GATT_PERM_WRITE, NULL, write_cmd, NULL),
    BT_GATT_CHARACTERISTIC(&uuid_log.uuid, BT_GATT_CHRC_READ | BT_GATT_CHRC_WRITE, BT_GATT_PERM_READ | BT_GATT_PERM_WRITE, read_log, write_log, NULL),
);

static int cfg_init(void) { k_work_init(&cmd_work, cmd_fn); return 0; }
SYS_INIT(cfg_init, APPLICATION, 90);
```

## src/cfg_svc.h
```c
// Configuration service: a Web Bluetooth page on either computer reads the hub's state (JSON) and
// sends short text commands. Both need an encrypted link, so only a paired computer can use them.
#pragma once
#include <stddef.h>
#include <stdbool.h>
#include <zephyr/bluetooth/conn.h>

// implemented in main.c
bool cfg_access_ok(struct bt_conn *conn);      // a paired computer, or any device while setup is open (then it is kept as the config link)
int cfg_status(char *buf, size_t n);          // writes the JSON state, returns its length
void cfg_command(const char *cmd);            // runs one command line, e.g. "pair 2", "swap 1 0", "name 1 Mac"
```

## src/hid_dev.h
```c
// HID over GATT peripheral that the computers pair with ("KVM CMP2"):
// one combined keyboard + mouse + consumer-control device, same report map as the ESP32 hub.
// Two computers can be connected at once; main.c decides which one is "active".
#pragma once
#include <stdbool.h>
#include <stdint.h>
#include <zephyr/bluetooth/conn.h>

#define NUM_HOSTS 4          // computers, in order from the left-most (0) to the right-most (3)

void hid_dev_init(void);
// make sure the computer-facing identity exists (call after settings_load)
void hid_dev_id_setup(void);
void hid_dev_fix_setup_identity(void);   // the setup advertisement gets C0:FF:33:8E:C0:00 (only before advertising has started)
int hid_dev_new_identity(void);      // a new Bluetooth address for the computers (only before advertising has started)
void hid_dev_adv_start(void);
void hid_dev_cfg_adv(bool on);                           // the phone's setup advertisement (own address, not a keyboard), on while setup is open
void hid_dev_beacon(bool on);                            // the always-on scannable advertisement for the config page
bool hid_dev_beacon_on(void);
void hid_dev_adv_start_later(void);     // 300 ms later, from a work item (use after a connection event)

// A computer connected (role peripheral). It is "pending" until main.c knows which computer it is.
void hid_dev_conn_open(struct bt_conn *c);
void hid_dev_conn_close(struct bt_conn *c);
bool hid_dev_is_host_conn(const struct bt_conn *c);
int  hid_dev_host_of(const struct bt_conn *c);          // 0..NUM_HOSTS-1, or -1 while pending
void hid_dev_swap_hosts(int a, int b);                  // computers a and b trade places (live links follow)
void hid_dev_assign(struct bt_conn *c, int host);       // c is computer `host`; an older link of it is dropped
bool hid_dev_connected(int host);
bool hid_dev_is_cfg_conn(struct bt_conn *c);           // this link came in on the phone's setup advertisement
void hid_dev_mark_config(struct bt_conn *c);           // this link uses the config service (a phone): keep it
int  hid_dev_disconnect_config(void);                  // drop every such link, returns how many
bool hid_dev_config_connected(void);
struct bt_conn *hid_dev_conn_for(int host);             // or NULL
struct bt_conn *hid_dev_pending(void);                  // a connected computer nobody has identified yet, or NULL

int hid_dev_send_keyboard(int host, const uint8_t rpt[8]);
int hid_dev_send_consumer(int host, uint16_t usage);

// Mouse movement goes to the active computer. It is summed up and sent when the previous
// notification has gone out, so nothing is lost and nothing waits on a timer.
void hid_dev_set_active(int host);
void hid_dev_set_resample(bool on);
bool hid_dev_toggle_resample(void);                     // even-out mode for the pointer; returns the new state
void hid_dev_set_mouse_gap(int ms);                      // all computers
void hid_dev_set_host_mouse(int h, int gap, bool even);   // one computer: report spacing in ms and "even out"
int hid_dev_host_gap(int h);
bool hid_dev_host_even(int h);
int hid_dev_get_mouse_gap(void);
void hid_dev_stroke(int per, int n, int ms, int reps);   // diagnosis only
void hid_dev_print_totals(void);                        // movement counted in and out since boot, for the stops test
void hid_dev_set_reroll(void (*cb)(void));              // called when the mouse's reports arrive lumpy
void hid_dev_jiggle(int ms);                            // diagnosis only
int hid_dev_cycle_mouse_gap(void);                      // 0 -> 8 -> 15 -> 22 ms minimum between mouse reports; returns the new value
void hid_dev_mouse_in(uint8_t buttons, int dx, int dy, int wheel, int pan);

// called when a computer sets the keyboard LEDs (caps lock etc.)
void hid_dev_on_leds(int host, uint8_t leds);
```

## src/nfc.c
```c
// NFC tag: a phone tapped on the coil on the XIAO's NFC pads reads one URL (the setup page).
#include <string.h>
#include <zephyr/kernel.h>
#include <zephyr/logging/log.h>
#include <nfc_t2t_lib.h>
#include <nfc/ndef/uri_msg.h>
#include "nfc.h"

LOG_MODULE_REGISTER(nfc, LOG_LEVEL_INF);

#define PAGE_URL "fducloux.github.io/NRF-KeMoSw/"      // the published setup page; "https://" is added by the tag

static uint8_t ndef_buf[128];
static volatile int n_field, n_read;
static struct k_work tap_work;

static void tap_fn(struct k_work *w) { nfc_tapped(); }

static void nfc_cb(void *ctx, nfc_t2t_event_t ev, const uint8_t *data, size_t len)
{
    switch (ev) {
    case NFC_T2T_EVENT_FIELD_ON: n_field++; break;
    case NFC_T2T_EVENT_DATA_READ: n_read++; k_work_submit(&tap_work); break;   // the phone read the tag
    default: break;
    }
}

void nfc_tag_init(void)
{
    uint32_t len = sizeof(ndef_buf);
    k_work_init(&tap_work, tap_fn);
    if (nfc_t2t_setup(nfc_cb, NULL) < 0) { LOG_ERR("nfc setup failed"); return; }
    if (nfc_ndef_uri_msg_encode(NFC_URI_HTTPS, (const uint8_t *)PAGE_URL, strlen(PAGE_URL), ndef_buf, &len) < 0) {
        LOG_ERR("nfc ndef encode failed"); return;
    }
    if (nfc_t2t_payload_set(ndef_buf, len) < 0) { LOG_ERR("nfc payload failed"); return; }
    if (nfc_t2t_emulation_start() < 0) { LOG_ERR("nfc start failed"); return; }
    LOG_INF("nfc tag on, https://%s", PAGE_URL);
}

int nfc_field_count(void) { return n_field; }
int nfc_read_count(void) { return n_read; }
```

## src/nfc.h
```c
// NFC tag emulation on the XIAO's two NFC pads (P0.09 / P0.10, so those two pins are not GPIO).
#pragma once
void nfc_tag_init(void);
int nfc_field_count(void);       // times a phone's field was seen
int nfc_read_count(void);        // times a phone read the tag
void nfc_tapped(void);           // implemented in main.c: called from a work item after a read
```

## src/ringlog.c
```c
// The hub keeps its own log: about the last 300 lines in RAM (roughly half an hour of connection events), readable over
// Bluetooth (config service characteristic ...0004) so nothing has to be unplugged to see what happened.
// It is a Zephyr log backend, so it receives everything the console receives, minus the busy mouse statistics.
#include <string.h>
#include <stdio.h>
#include <zephyr/kernel.h>
#include <zephyr/logging/log_backend.h>
#include <zephyr/logging/log_backend_std.h>
#include <zephyr/logging/log_output.h>
#include <zephyr/logging/log_core.h>
#include "ringlog.h"

#define N_ENT 300
#define TXT   150
#define TS    19                       // length of the "[00:00:03.001,495] " time stamp in front of every line

struct ent { uint32_t seq; uint16_t rep; char text[TXT]; };
static struct ent ring[N_ENT];
static uint32_t next_seq = 1;
static struct k_spinlock lock;
static char line[TXT];
static size_t line_len;

static void push(const char *text)
{
    if (strstr(text, "mouse 2 s,") || !strncmp(text, "alive ", 6) || strstr(text, "lumpy arrivals") || strstr(text, "hub: slot 1 link ")) return;   // the pointer statistics and the console heartbeat repeat every 2 s: not worth the space
    k_spinlock_key_t k = k_spin_lock(&lock);
    struct ent *last = next_seq > 1 ? &ring[(next_seq - 2) % N_ENT] : NULL;
    if (last && strlen(text) > TS && strlen(last->text) > TS && !strcmp(last->text + TS, text + TS) && last->rep < 60000) {
        last->rep++;                                                         // the same line again (a computer that keeps reconnecting): count it
    } else {
        struct ent *e = &ring[(next_seq - 1) % N_ENT];
        e->seq = next_seq++; e->rep = 1;
        strncpy(e->text, text, TXT - 1); e->text[TXT - 1] = 0;
    }
    k_spin_unlock(&lock, k);
}

static int char_out(uint8_t *data, size_t length, void *ctx)
{
    for (size_t i = 0; i < length; i++) {
        char c = data[i];
        if (c == '\n' || c == '\r') { if (line_len) { line[line_len] = 0; push(line); line_len = 0; } }
        else if (line_len < TXT - 1) line[line_len++] = c;
    }
    return length;
}
static uint8_t out_buf[160];
LOG_OUTPUT_DEFINE(ringlog_output, char_out, out_buf, sizeof(out_buf));

static void process(const struct log_backend *const backend, union log_msg_generic *msg)
{
    log_format_func_t f = log_format_func_t_get(LOG_OUTPUT_TEXT);
    f(&ringlog_output, &msg->log, log_backend_std_get_flags() & ~LOG_OUTPUT_FLAG_COLORS);
}
static void init_cb(const struct log_backend *const backend) {}
static void panic_cb(const struct log_backend *const backend) {}
static void dropped_cb(const struct log_backend *const backend, uint32_t cnt) { log_backend_std_dropped(&ringlog_output, cnt); }
static const struct log_backend_api ringlog_api = { .process = process, .init = init_cb, .panic = panic_cb, .dropped = dropped_cb };
LOG_BACKEND_DEFINE(ringlog_backend, ringlog_api, true);

// Text of the lines with sequence number >= from, "seq|line" (and " (xN)" for repeats), whole lines only, up to n bytes.
size_t ringlog_read(uint32_t from, char *out, size_t n)
{
    size_t used = 0;
    k_spinlock_key_t k = k_spin_lock(&lock);
    uint32_t oldest = next_seq > N_ENT ? next_seq - N_ENT : 1;
    for (uint32_t s = from > oldest ? from : oldest; s < next_seq; s++) {
        const struct ent *e = &ring[(s - 1) % N_ENT];
        int w = e->rep > 1 ? snprintf(out + used, n - used, "%u|%s (x%u)\n", (unsigned)e->seq, e->text, e->rep)
                           : snprintf(out + used, n - used, "%u|%s\n", (unsigned)e->seq, e->text);
        if (w < 0 || (size_t)w >= n - used) { out[used] = 0; break; }       // does not fit: leave it for the next read
        used += w;
    }
    k_spin_unlock(&lock, k);
    return used;
}
```

## src/ringlog.h
```c
// RAM log of the last ~150 lines, readable over Bluetooth.
#pragma once
#include <stddef.h>
#include <stdint.h>
size_t ringlog_read(uint32_t from, char *out, size_t n);
```
